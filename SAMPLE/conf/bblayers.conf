## SAMPLE/conf/bblayers.conf
```bitbake
# POKY_BBLAYERS_CONF_VERSION is increased each time build/conf/bblayers.conf
# changes incompatibly
POKY_BBLAYERS_CONF_VERSION = "2"

BBPATH = "${TOPDIR}"
BBFILES ?= ""

BBLAYERS ?= " \
  /home/rom/Desktop/yocto/poky/meta \
  /home/rom/Desktop/yocto/poky/meta-poky \
  /home/rom/Desktop/yocto/poky/meta-yocto-bsp \
  /home/rom/Desktop/yocto/layers/meta-raspberrypi \
  /home/rom/Desktop/yocto/custom-layers/meta-romrobotics \
  "


  
```

## conf/bblayers.conf
```bitbake
# POKY_BBLAYERS_CONF_VERSION is increased each time build/conf/bblayers.conf
# changes incompatibly
POKY_BBLAYERS_CONF_VERSION = "2"

BBPATH = "${TOPDIR}"
BBFILES ?= ""

BBLAYERS ?= " \
  /home/robot/Desktop/yocto/poky/meta \
  /home/robot/Desktop/yocto/poky/meta-poky \
  /home/robot/Desktop/yocto/poky/meta-yocto-bsp \
  /home/robot/Desktop/yocto/layers/meta-raspberrypi \
  /home/robot/Desktop/yocto/layers/meta-romrobotics \
  /home/robot/Desktop/yocto/layers/meta-ros/meta-ros-common \
  /home/robot/Desktop/yocto/layers/meta-ros/meta-ros1 \
  /home/robot/Desktop/yocto/layers/meta-ros/meta-ros1-noetic \
  /home/robot/Desktop/yocto/layers/meta-openembedded/meta-python \
  /home/robot/Desktop/yocto/layers/meta-openembedded/meta-oe \
  /home/robot/Desktop/yocto/layers/meta-ros/meta-ros-backports-gatesgarth \
  /home/robot/Desktop/yocto/layers/meta-ros/meta-ros-backports-hardknott \
  "
```

## conf/local.conf
```bitbake
MACHINE ?= "raspberrypi4-64"


DISTRO ?= "poky"

#PACKAGE_CLASSES ?= "package_rpm"


EXTRA_IMAGE_FEATURES ?= "debug-tweaks"


USER_CLASSES ?= "buildstats image-mklibs image-prelink"


PATCHRESOLVE = "noop"


BB_DISKMON_DIRS ??= "\
    STOPTASKS,${TMPDIR},1G,100K \
    STOPTASKS,${DL_DIR},1G,100K \
    STOPTASKS,${SSTATE_DIR},1G,100K \
    STOPTASKS,/tmp,100M,100K \
    ABORT,${TMPDIR},100M,1K \
    ABORT,${DL_DIR},100M,1K \
    ABORT,${SSTATE_DIR},100M,1K \
    ABORT,/tmp,10M,1K"


PACKAGECONFIG_append_pn-qemu-system-native = " sdl"


CONF_VERSION = "1"

###########################################################################
# ROS-ADDITIONS-BEGIN

ROS_LOCAL_CONF_SETTINGS_VERSION := "2.2"
DISTRO ?= "${MCF_DISTRO}"
MACHINE ?= "raspberrypi4-64"
ROS_DISTRO_VERSION_APPEND ?= "+${MCF_OPENEMBEDDED_VERSION}"
ROS_WEBOS_DISTRO_VERSION_APPEND ?= ".${MCF_WEBOS_BUILD_NUMBER}"
ROS_OE_RELEASE_SERIES_SUFFIX ?= "-${ROS_OE_RELEASE_SERIES}"

ROS_COMMON_ARTIFACTS ?= "/home/robot/Desktop/yocto/build/noetic/rom_cache/"

DL_DIR ?= "${ROS_COMMON_ARTIFACTS}/downloads"
SSTATE_DIR ?= "${ROS_COMMON_ARTIFACTS}/sstate-cache${ROS_OE_RELEASE_SERIES_SUFFIX}"
TMPDIR ?= "${ROS_COMMON_ARTIFACTS}/BUILD-${DISTRO}-${ROS_DISTRO}${ROS_OE_RELEASE_SERIES_SUFFIX}"
TCLIBCAPPEND := ""
BB_NUMBER_THREADS ?= "${@min(int(bb.utils.cpu_count()), 20)}"
PARALLEL_MAKE ?= "-j ${BB_NUMBER_THREADS}"
INHERIT += "rm_work"

# ROS-ADDITIONS-END


#*********  ROM ROBOTICS မှ စတင်ပြင်ဆင်သော အပိုင်း ဖြစ်ပါသည်။  *********#
PACKAGE_INSTALL_append = " psplash-bar"
SPLASH = "psplash-bar"

EXTRA_IMAGE_FEATURES += "package-management"
PACKAGE_CLASSES ?= "package_ipk"
BB_NUMBER_THREADS ?= "6"
PARALLEL_MAKE ?= "-j 6"

IMAGE_FSTYPES = "tar.xz ext3 rpi-sdimg"

LICENSE_FLAGSWHITELIST = "commercial"

INHERIT += "extrausers"
EXTRA_USERS_PARAMS = "useradd rom; \
					  usermod -p 'robotics' rom; \
					  usermod -a -G sudo rom; \
					  usermod -P 1234 root; \
					  "
INHERIT += "chageusers"
CHAGE_USERS_PARAMS = "chage -d0 root; "

#*************  ROM ROBOTICS မှ ပြင်ဆင်ပြီးဆုံးသည်။  ****************#
```

## meta-digger/conf/bblayers.conf
```bitbake
# POKY_BBLAYERS_CONF_VERSION is increased each time build/conf/bblayers.conf
# changes incompatibly
POKY_BBLAYERS_CONF_VERSION = "2"

BBPATH = "${TOPDIR}"
BBFILES ?= ""

BBLAYERS ?= " \
  /home/tupi/yocto/poky/meta \
  /home/tupi/yocto/poky/meta-poky \
  /home/tupi/yocto/meta-digger \
  /home/tupi/yocto/meta-raspberrypi \
  /home/tupi/yocto/meta-openembedded/meta-networking \
  /home/tupi/yocto/meta-openembedded/meta-oe \
  /home/tupi/yocto/meta-openembedded/meta-python \
  "
```

## meta-digger/conf/layer.conf
```bitbake
# We have a conf and classes directory, add to BBPATH
BBPATH .= ":${LAYERDIR}"

# We have recipes-* directories, add to BBFILES
BBFILES += "${LAYERDIR}/recipes-*/*/*.bb \
            ${LAYERDIR}/recipes-*/*/*.bbappend"

BBFILE_COLLECTIONS += "meta-digger"
BBFILE_PATTERN_meta-digger = "^${LAYERDIR}/"
BBFILE_PRIORITY_meta-digger = "6"

LAYERDEPENDS_meta-digger = "core"
LAYERSERIES_COMPAT_meta-digger = "dunfell"
```

## meta-romrobotics/conf/layer.conf
```bitbake
# We have a conf and classes directory, add to BBPATH
BBPATH .= ":${LAYERDIR}"

# We have recipes-* directories, add to BBFILES
BBFILES += "${LAYERDIR}/recipes-*/*/*.bb \
            ${LAYERDIR}/recipes-*/*/*.bbappend"

BBFILE_COLLECTIONS += "meta-romrobotics"
BBFILE_PATTERN_meta-romrobotics = "^${LAYERDIR}/"
BBFILE_PRIORITY_meta-romrobotics = "6"

LAYERDEPENDS_meta-romrobotics = "core"
LAYERSERIES_COMPAT_meta-romrobotics = "dunfell"



#*********  ROM ROBOTICS မှ စတင်ပြင်ဆင်သော အပိုင်း ဖြစ်ပါသည်။  *********#

LICENSE_FLAGSWHITELIST = "commercial"

INHERIT += "extrausers"
EXTRA_USERS_PARAMS = "useradd rom; \
					  usermod -p 'robotics' rom; \
					  usermod -a -G sudo rom; \
					  usermod -P myanmarrobotteam root; \
					  "

#MACHINE_FEATURES += "pitft pitft35r
#MACHINE_FEATURES += "pitft pitft28r
```
